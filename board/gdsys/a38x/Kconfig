## board/gdsys/a38x/Kconfig
```kconfig
if TARGET_CONTROLCENTERDC

config SYS_BOARD
	default "a38x"

config SYS_VENDOR
	default "gdsys"

config SYS_SOC
	default "mvebu"

config SYS_CONFIG_NAME
	default "controlcenterdc"

endif
```

## board/solidrun/clearfog/Kconfig
```kconfig
if TARGET_CLEARFOG || TARGET_CLEARFOG_BASE

menu "ClearFog Port Configuration"

choice
        prompt "ClearFog CON2 Configuration"
	default CLEARFOG_CON2_PCI
	depends on TARGET_CLEARFOG

config CLEARFOG_CON2_PCI
        bool "PCI"

config CLEARFOG_CON2_SATA
        bool "SATA"

endchoice

choice
        prompt "ClearFog CON3 Configuration"
	default CLEARFOG_CON3_PCI

config CLEARFOG_CON3_PCI
        bool "PCI"

config CLEARFOG_CON3_SATA
        bool "SATA"

endchoice

choice
        prompt "ClearFog SFP Speed"
	default CLEARFOG_SFP_1GB

config CLEARFOG_SFP_1GB
        bool "1Gbps"

config CLEARFOG_SFP_25GB
        bool "2.5Gbps"

endchoice

endmenu

endif
```

## board/solidrun/imx8mq_hb/Kconfig
```kconfig
if TARGET_IMX8MQ_HB

config SYS_BOARD
	default "imx8mq_hb"

config SYS_VENDOR
	default "solidrun"

config SYS_CONFIG_NAME
	default "imx8mq_hb"

source "board/freescale/common/Kconfig"

endif
```

## configs/imx8mq_hb_defconfig
```kconfig
CONFIG_ARM=y
CONFIG_ARCH_IMX8M=y
CONFIG_SYS_TEXT_BASE=0x40200000
CONFIG_SYS_MALLOC_F_LEN=0x2000
CONFIG_SPL_GPIO_SUPPORT=y
CONFIG_SPL_LIBCOMMON_SUPPORT=y
CONFIG_SPL_LIBGENERIC_SUPPORT=y
CONFIG_TARGET_IMX8MQ_HB=y
CONFIG_SPL_SERIAL_SUPPORT=y
CONFIG_SPL_MMC_SUPPORT=y
CONFIG_SPL_I2C_SUPPORT=y
CONFIG_SPL_POWER_SUPPORT=y
CONFIG_SPL_WATCHDOG_SUPPORT=y
CONFIG_SAVED_DRAM_TIMING_BASE=0x40000000
CONFIG_DEFAULT_DEVICE_TREE="fsl-imx8mq-hb"
CONFIG_OF_LIST="fsl-imx8mq-hb"
CONFIG_SYS_EXTRA_OPTIONS="IMX_CONFIG=arch/arm/mach-imx/imx8m/imximage.cfg"
CONFIG_SPL_FIT_GENERATOR="arch/arm/mach-imx/mkimage_fit_atf.sh"
CONFIG_OF_BOARD_SETUP=y
CONFIG_SUPPORT_RAW_INITRD=y
CONFIG_FIT=y
CONFIG_SPL_LOAD_FIT=y
CONFIG_DISTRO_DEFAULTS=y
#CONFIG_SYS_EXTRA_OPTIONS="IMX_CONFIG=arch/arm/mach-imx/spl_sd.cfg"
CONFIG_SPL=y
CONFIG_SPL_BOARD_INIT=y
CONFIG_HUSH_PARSER=y
CONFIG_CMD_CACHE=y
CONFIG_CMD_DHCP=y
CONFIG_CMD_GPIO=y
CONFIG_CMD_I2C=y
CONFIG_CMD_MMC=y
CONFIG_CMD_MMC_RPMB=y
CONFIG_CMD_PART=y
CONFIG_CMD_PING=y
CONFIG_CMD_REGULATOR=y
CONFIG_CMD_EXT2=y
CONFIG_CMD_EXT4=y
CONFIG_CMD_EXT4_WRITE=y
CONFIG_CMD_FAT=y
CONFIG_CMD_FS_GENERIC=y
CONFIG_CMD_FS_UUID=y
CONFIG_CMD_USB=y
CONFIG_DOS_PARTITION=y
CONFIG_EFI_PARTITION=y
CONFIG_EFI_PARTITION_ENTRIES_NUMBERS=128
CONFIG_EFI_PARTITION_ENTRIES_OFF=0
CONFIG_PARTITION_UUIDS=y
CONFIG_PARTITION_TYPE_GUID=y
CONFIG_ENV_IS_IN_MMC=y
CONFIG_OF_CONTROL=y
CONFIG_DM_GPIO=y
CONFIG_DM_I2C=y
CONFIG_DM_MMC=y
CONFIG_PHYLIB=y
# CONFIG_PHY_ADDR_ENABLE is not set
# CONFIG_B53_SWITCH is not set
# CONFIG_MV88E61XX_SWITCH is not set
# CONFIG_PHYLIB_10G is not set
# CONFIG_PHY_AQUANTIA is not set
CONFIG_PHY_ATHEROS=y
# CONFIG_PHY_BROADCOM is not set
# CONFIG_PHY_CORTINA is not set
# CONFIG_PHY_DAVICOM is not set
# CONFIG_PHY_ET1011C is not set
# CONFIG_PHY_LXT is not set
# CONFIG_PHY_MARVELL is not set
# CONFIG_PHY_MESON_GXL is not set
# CONFIG_PHY_MICREL is not set
# CONFIG_PHY_MSCC is not set
# CONFIG_PHY_NATSEMI is not set
# CONFIG_PHY_REALTEK is not set
# CONFIG_PHY_SMSC is not set
# CONFIG_PHY_TERANETICS is not set
# CONFIG_PHY_TI is not set
# CONFIG_PHY_VITESSE is not set
# CONFIG_PHY_XILINX is not set
# CONFIG_PHY_FIXED is not set
# CONFIG_FSL_PFE is not set
CONFIG_DM_ETH=y
CONFIG_PINCTRL=y
CONFIG_PINCTRL_IMX8M=y
CONFIG_SYS_I2C_MXC=y
CONFIG_DM_PMIC_PFUZE100=y
CONFIG_DM_REGULATOR=y
CONFIG_DM_REGULATOR_PFUZE100=y
CONFIG_DM_REGULATOR_FIXED=y
CONFIG_DM_REGULATOR_GPIO=y
CONFIG_DM_THERMAL=y
CONFIG_FIT_EXTERNAL_OFFSET=0x3000
CONFIG_FSL_ESDHC=y
CONFIG_MXC_GPIO=y
CONFIG_MXC_UART=y
CONFIG_NET_RANDOM_ETHADDR=y
CONFIG_NET_RANDOM_ETHADDR_OUI="d0:63:b4:00:00:00"
CONFIG_PHY=y
# CONFIG_SPL_PHY is not set
# CONFIG_NOP_PHY is not set
CONFIG_PHY_FSL_IMX8MQ_USB=y
CONFIG_USB=y
CONFIG_DM_USB=y
CONFIG_USB_HOST=y
CONFIG_DM_USB_GADGET=y
CONFIG_USB_XHCI_HCD=y
CONFIG_USB_XHCI_DWC3=y
# CONFIG_USB_XHCI_DWC3_OF_SIMPLE is not set
# CONFIG_USB_XHCI_PCI is not set
# CONFIG_USB_XHCI_FSL is not set
CONFIG_USB_XHCI_IMX8M=y
# CONFIG_USB_EHCI_HCD is not set
# CONFIG_USB_OHCI_HCD is not set
# CONFIG_USB_UHCI_HCD is not set
# CONFIG_USB_DWC2 is not set
CONFIG_USB_DWC3=y
# CONFIG_USB_DWC3_HOST is not set
CONFIG_USB_DWC3_GADGET=y
# CONFIG_USB_DWC3_OMAP is not set
CONFIG_USB_DWC3_GENERIC=y
# CONFIG_USB_KEYBOARD is not set
CONFIG_USB_GADGET=y
CONFIG_USB_GADGET_MANUFACTURER="SolidRun"
CONFIG_USB_GADGET_VENDOR_NUM=0x0525
CONFIG_USB_GADGET_PRODUCT_NUM=0xa4a5
# CONFIG_USB_GADGET_ATMEL_USBA is not set
# CONFIG_USB_GADGET_BCM_UDC_OTG_PHY is not set
# CONFIG_USB_GADGET_DWC2_OTG is not set
# CONFIG_CI_UDC is not set
CONFIG_USB_GADGET_VBUS_DRAW=2
CONFIG_USB_GADGET_DUALSPEED=y
CONFIG_USB_GADGET_DOWNLOAD=y
CONFIG_USB_FUNCTION_MASS_STORAGE=y
# CONFIG_USB_FUNCTION_ROCKUSB is not set
# CONFIG_USB_FUNCTION_SDP is not set
# CONFIG_USB_FUNCTION_THOR is not set
# CONFIG_USB_ETHER is not set
# CONFIG_USB_HOST_ETHER is not set
CONFIG_USB_STORAGE=y
```

## net/Kconfig
```kconfig
#
# Network configuration
#

menuconfig NET
	bool "Networking support"
	default y

if NET

config NET_RANDOM_ETHADDR
	bool "Random ethaddr if unset"
	help
	  Selecting this will allow the Ethernet interface to function
	  even when the ethaddr variable for that interface is unset.
	  A new MAC address will be generated on every boot and it will
	  not be added to the environment.

config NET_RANDOM_ETHADDR_OUI 
        string "OUI for random Ethernet device mac address"
	depends on NET_RANDOM_ETHADDR
        default "de:ad:be:00:00:00"
        help
          Ethernet MAC address to use as the reference OUI for additional 
          random addresses. This allows generating relatively sane
	  vendor identifiable MACs without stepping on properly fused
	  devices. 

config NETCONSOLE
	bool "NetConsole support"
	help
	  Support the 'nc' input/output device for networked console.
	  See README.NetConsole for details.

endif   # if NET
```
